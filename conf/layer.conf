## conf/layer.conf
```bitbake
# We have a conf and classes directory, add to BBPATH
BBPATH .= ":${LAYERDIR}"

# We have recipes-* directories, add to BBFILES
BBFILES += "${LAYERDIR}/recipes*/*/*.bb \
        ${LAYERDIR}/recipes*/*/*.bbappend"

BBFILE_COLLECTIONS += "pbump"
BBFILE_PATTERN_pbump = "^${LAYERDIR}/"
BBFILE_PRIORITY_pbump = "5"

LAYERSERIES_COMPAT_pbump = "sumo thud warrior zeus dunfell"
```
